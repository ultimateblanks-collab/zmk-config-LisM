## config/west.yml
```yaml
manifest:
  remotes:
    - name: zmkfirmware
      url-base: https://github.com/zmkfirmware
    - name: sekigon-gonnoc
      url-base: https://github.com/sekigon-gonnoc
    - name: caksoylar
      url-base: https://github.com/caksoylar
    - name: 4mplelab
      url-base: https://github.com/4mplelab
    - name: zettaface
      url-base: https://github.com/zettaface
    - name: ultimateblanks-collab
      url-base: https://github.com/ultimateblanks-collab
  projects:
    - name: zmk
      remote: zmkfirmware
      revision: v0.3.0
      import: app/west.yml
    - name: zmk-driver-paw3222
      remote: ultimateblanks-collab
      revision: acc0.1
    - name: zmk-rgbled-widget
      remote: ultimateblanks-collab
      revision: ae2864f400774d6cfc7d65b50f74605bfe5e9031
    - name: zmk-feature-charge-indicator
      remote: ultimateblanks-collab
      revision: 57017e89fa64a731803f8b45cb047d8300fdc982
    - name: zmk-input-processor-keybind
      remote: ultimateblanks-collab
      revision: 3d62fbe08e05a28c97b3136a4a25d6b62567d762
    - name: zmk-scroll-snap
      remote: ultimateblanks-collab
      revision: v1
  self:
    path: config
```
